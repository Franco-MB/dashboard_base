## main/Kconfig.projbuild
```kconfig
menu "Example Configuration"

    config ML_WIFI_SSID
        string "WiFi SSID"
        default ""
        help
            SSID of the WiFi network to connect to.
            This is stored in sdkconfig which should be git-ignored.

    config ML_WIFI_PASSWORD
        string "WiFi Password"
        default ""
        help
            Password for the WiFi network.
            This is stored in sdkconfig which should be git-ignored.

    config ML_TAILSCALE_AUTH_KEY
        string "Tailscale Auth Key"
        default ""
        help
            Tailscale authentication key from https://login.tailscale.com/admin/settings/keys
            Generate a reusable + ephemeral key for development.
            This is stored in sdkconfig which should be git-ignored.

    config ML_EXAMPLE_TARGET_PEER_IP
        string "Target Peer VPN IP (for sending)"
        default ""
        help
            VPN IP of the peer to send "hello" messages to (e.g., "100.103.181.24").
            Leave empty to only receive (no outgoing messages).
            The peer should run: nc -lu 9000

endmenu

menu "Dashboard Configuration"

    config DASHBOARD_PORT
        int "Dashboard HTTP/WebSocket port"
        default 8080
        help
            TCP port for the Dashboard web portal and WebSocket (/ws).
            Default is 8080 to avoid conflict with MicroLink config httpd (port 80).

endmenu
```
